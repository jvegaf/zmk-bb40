## config/west.yml
```yaml
manifest:
  remotes:
    - name: zmkfirmware
      url-base: https://github.com/zmkfirmware

    # Add the users with the repositories you need to this list.
    - name: mechwild
      url-base: https://github.com/mechwild
    - name: lesshonor
      url-base: https://github.com/lesshonor
  projects:
    - name: zmk
      remote: zmkfirmware
      revision: main
      import: app/west.yml
    - name: mechwild-zmk-keyboards # Add the name of the repository as a project.
      remote: lesshonor            # This has to match the name for the user you put in the "remote" earlier.
      revision: main               # This is the the branch of the repository you need. Most of the time you can leave this as main.
  self:
    path: config
```
